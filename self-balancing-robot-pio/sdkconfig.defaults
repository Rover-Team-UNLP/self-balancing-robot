## self-balancing-robot-pio/sdkconfig.defaults
```kconfig
# ESP32 Configuration Defaults for Self-Balancing Robot

# Compiler options
CONFIG_COMPILER_OPTIMIZATION_SIZE=y

# FreeRTOS
CONFIG_FREERTOS_HZ=1000

# ESP32-specific
CONFIG_ESP32_DEFAULT_CPU_FREQ_240=y
CONFIG_ESP32_DEFAULT_CPU_FREQ_MHZ=240

# Memory
CONFIG_SPIRAM_SUPPORT=n

# WiFi (disabled by default, enable if needed)
CONFIG_ESP32_WIFI_ENABLED=n

# Bluetooth (disabled by default, enable if needed)
CONFIG_BT_ENABLED=n

# Log output
CONFIG_LOG_DEFAULT_LEVEL_INFO=y
CONFIG_LOG_DEFAULT_LEVEL=3

# Main task
CONFIG_ESP_MAIN_TASK_STACK_SIZE=8192

# WDT
CONFIG_ESP_TASK_WDT_TIMEOUT_S=10
CONFIG_ESP_TASK_WDT_CHECK_IDLE_TASK_CPU0=y
CONFIG_ESP_TASK_WDT_CHECK_IDLE_TASK_CPU1=y

# Flash settings
CONFIG_ESPTOOLPY_FLASHMODE_DIO=y
CONFIG_ESPTOOLPY_FLASHFREQ_40M=y
CONFIG_ESPTOOLPY_FLASHSIZE_4MB=y

# Serial console
CONFIG_ESP_CONSOLE_UART_DEFAULT=y
CONFIG_ESP_CONSOLE_UART_NUM=0
CONFIG_ESP_CONSOLE_UART_BAUDRATE_115200=y
```
